## Kconfig
```kconfig
# Copyright 2026 Roman Kuzmitskii (@damex)
# SPDX-License-Identifier: MIT

if DT_HAS_ZMK_BEHAVIOR_STEPPED_SCROLL_ENABLED

module = ZMK_BEHAVIOR_STEPPED_SCROLL
module-str = zmk_behavior_stepped_scroll
source "subsys/logging/Kconfig.template.log_config"

endif
```

## dts/bindings/behaviors/zmk,behavior-stepped-scroll.yaml
```yaml
# Copyright 2026 Roman Kuzmitskii (@damex)
# SPDX-License-Identifier: MIT

description: Emit one discrete relative scroll tick per binding press.

compatible: "zmk,behavior-stepped-scroll"

include: one_param.yaml

properties:
  input-code:
    type: int
    required: true
```
